## board/opendingux/package/barony/Config.in
```kconfig
config BR2_PACKAGE_BARONY
	bool "barony"
	select BR2_PACKAGE_SDL2
	select BR2_PACKAGE_SDL2_IMAGE
	select BR2_PACKAGE_SDL2_MIXER
	select BR2_PACKAGE_SDL2_TTF
	select BR2_PACKAGE_TREMOR
	select BR2_PACKAGE_LIBPNG
	select BR2_PACKAGE_PHYSFS
	help
	  Barony is a 3D, first-person roguelike.
	
	  http://www.baronygame.com/
```

## board/opendingux/package/od-cpu-governor-selector/Config.in
```kconfig
config BR2_PACKAGE_OD_CPU_GOVERNOR_SELECTOR
	bool "od-cpu-governor-selector"
	help
	  UI for selecting the CPU governor.


if BR2_PACKAGE_OD_CPU_GOVERNOR_SELECTOR

config BR2_PACKAGE_OD_CPU_GOVERNOR_SELECTOR_SYSTEM_APP
	bool "Install as a system app instead of an OPK"

endif
```
